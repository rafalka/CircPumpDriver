PACK_DATE(2017, 1, 1), /* niedziela - Nowy Rok, Œwiêtej Bo¿ej Rodzicielki */
PACK_DATE(2017, 1, 6), /* pi¹tek - Trzech Króli (Objawienie Pañskie) */
PACK_DATE(2017, 4,16), /* niedziela - Wielkanoc */
PACK_DATE(2017, 4,17), /* poniedzia³ek - Poniedzia³ek Wielkanocny */
PACK_DATE(2017, 5, 1), /* poniedzia³ek - Œwiêto Pracy */
PACK_DATE(2017, 5, 3), /* œroda - Œwiêto Konstytucji 3 maja */
PACK_DATE(2017, 6, 4), /* niedziela - Zes³anie Ducha Œwiêtego (Zielone Œwi¹tki) */
PACK_DATE(2017, 6,15), /* czwartek - Bo¿e Cia³o */
PACK_DATE(2017, 8,15), /* wtorek - Œwiêto Wojska Polskiego, Wniebowziêcie Najœwiêtszej Maryi Panny */
PACK_DATE(2017,11, 1), /* œroda - Wszystkich Œwiêtych */
PACK_DATE(2017,11,11), /* sobota - Œwiêto Niepodleg³oœci */
PACK_DATE(2017,12,25), /* poniedzia³ek - Bo¿e Narodzenie (pierwszy dzieñ) */
PACK_DATE(2017,12,26), /* wtorek - Bo¿e Narodzenie (drugi dzieñ) */
PACK_DATE(2018, 1, 1), /* poniedzia³ek - Nowy Rok, Œwiêtej Bo¿ej Rodzicielki */
PACK_DATE(2018, 1, 6), /* sobota - Trzech Króli (Objawienie Pañskie) */
PACK_DATE(2018, 4, 1), /* niedziela - Wielkanoc */
PACK_DATE(2018, 4, 2), /* poniedzia³ek - Poniedzia³ek Wielkanocny */
PACK_DATE(2018, 5, 1), /* wtorek - Œwiêto Pracy */
PACK_DATE(2018, 5, 3), /* czwartek - Œwiêto Konstytucji 3 maja */
PACK_DATE(2018, 5,20), /* niedziela - Zes³anie Ducha Œwiêtego (Zielone Œwi¹tki) */
PACK_DATE(2018, 5,31), /* czwartek - Bo¿e Cia³o */
PACK_DATE(2018, 8,15), /* œroda - Œwiêto Wojska Polskiego, Wniebowziêcie Najœwiêtszej Maryi Panny */
PACK_DATE(2018,11, 1), /* czwartek - Wszystkich Œwiêtych */
PACK_DATE(2018,11,11), /* niedziela - Œwiêto Niepodleg³oœci */
PACK_DATE(2018,12,25), /* wtorek - Bo¿e Narodzenie (pierwszy dzieñ) */
PACK_DATE(2018,12,26), /* œroda - Bo¿e Narodzenie (drugi dzieñ) */
PACK_DATE(2019, 1, 1), /* wtorek - Nowy Rok, Œwiêtej Bo¿ej Rodzicielki */
PACK_DATE(2019, 1, 6), /* niedziela - Trzech Króli (Objawienie Pañskie) */
PACK_DATE(2019, 4,21), /* niedziela - Wielkanoc */
PACK_DATE(2019, 4,22), /* poniedzia³ek - Poniedzia³ek Wielkanocny */
PACK_DATE(2019, 5, 1), /* œroda - Œwiêto Pracy */
PACK_DATE(2019, 5, 3), /* pi¹tek - Œwiêto Konstytucji 3 maja */
PACK_DATE(2019, 6, 9), /* niedziela - Zes³anie Ducha Œwiêtego (Zielone Œwi¹tki) */
PACK_DATE(2019, 6,20), /* czwartek - Bo¿e Cia³o */
PACK_DATE(2019, 8,15), /* czwartek - Œwiêto Wojska Polskiego, Wniebowziêcie Najœwiêtszej Maryi Panny */
PACK_DATE(2019,11, 1), /* pi¹tek - Wszystkich Œwiêtych */
PACK_DATE(2019,11,11), /* poniedzia³ek - Œwiêto Niepodleg³oœci */
PACK_DATE(2019,12,25), /* œroda - Bo¿e Narodzenie (pierwszy dzieñ) */
PACK_DATE(2019,12,26), /* czwartek - Bo¿e Narodzenie (drugi dzieñ) */
PACK_DATE(2020, 1, 1), /* œroda - Nowy Rok, Œwiêtej Bo¿ej Rodzicielki */
PACK_DATE(2020, 1, 6), /* poniedzia³ek - Trzech Króli (Objawienie Pañskie) */
PACK_DATE(2020, 4,12), /* niedziela - Wielkanoc */
PACK_DATE(2020, 4,13), /* poniedzia³ek - Poniedzia³ek Wielkanocny */
PACK_DATE(2020, 5, 1), /* pi¹tek - Œwiêto Pracy */
PACK_DATE(2020, 5, 3), /* niedziela - Œwiêto Konstytucji 3 maja */
PACK_DATE(2020, 5,31), /* niedziela - Zes³anie Ducha Œwiêtego (Zielone Œwi¹tki) */
PACK_DATE(2020, 6,11), /* czwartek - Bo¿e Cia³o */
PACK_DATE(2020, 8,15), /* sobota - Œwiêto Wojska Polskiego, Wniebowziêcie Najœwiêtszej Maryi Panny */
PACK_DATE(2020,11, 1), /* niedziela - Wszystkich Œwiêtych */
PACK_DATE(2020,11,11), /* œroda - Œwiêto Niepodleg³oœci */
PACK_DATE(2020,12,25), /* pi¹tek - Bo¿e Narodzenie (pierwszy dzieñ) */
PACK_DATE(2020,12,26), /* sobota - Bo¿e Narodzenie (drugi dzieñ) */
PACK_DATE(2021, 1, 1), /* pi¹tek - Nowy Rok, Œwiêtej Bo¿ej Rodzicielki */
PACK_DATE(2021, 1, 6), /* œroda - Trzech Króli (Objawienie Pañskie) */
PACK_DATE(2021, 4, 4), /* niedziela - Wielkanoc */
PACK_DATE(2021, 4, 5), /* poniedzia³ek - Poniedzia³ek Wielkanocny */
PACK_DATE(2021, 5, 1), /* sobota - Œwiêto Pracy */
PACK_DATE(2021, 5, 3), /* poniedzia³ek - Œwiêto Konstytucji 3 maja */
PACK_DATE(2021, 5,23), /* niedziela - Zes³anie Ducha Œwiêtego (Zielone Œwi¹tki) */
PACK_DATE(2021, 6, 3), /* czwartek - Bo¿e Cia³o */
PACK_DATE(2021, 8,15), /* niedziela - Œwiêto Wojska Polskiego, Wniebowziêcie Najœwiêtszej Maryi Panny */
PACK_DATE(2021,11, 1), /* poniedzia³ek - Wszystkich Œwiêtych */
PACK_DATE(2021,11,11), /* czwartek - Œwiêto Niepodleg³oœci */
PACK_DATE(2021,12,25), /* sobota - Bo¿e Narodzenie (pierwszy dzieñ) */
PACK_DATE(2021,12,26), /* niedziela - Bo¿e Narodzenie (drugi dzieñ) */
PACK_DATE(2022, 1, 1), /* sobota - Nowy Rok, Œwiêtej Bo¿ej Rodzicielki */
PACK_DATE(2022, 1, 6), /* czwartek - Trzech Króli (Objawienie Pañskie) */
PACK_DATE(2022, 4,17), /* niedziela - Wielkanoc */
PACK_DATE(2022, 4,18), /* poniedzia³ek - Poniedzia³ek Wielkanocny */
PACK_DATE(2022, 5, 1), /* niedziela - Œwiêto Pracy */
PACK_DATE(2022, 5, 3), /* wtorek - Œwiêto Konstytucji 3 maja */
PACK_DATE(2022, 6, 5), /* niedziela - Zes³anie Ducha Œwiêtego (Zielone Œwi¹tki) */
PACK_DATE(2022, 6,16), /* czwartek - Bo¿e Cia³o */
PACK_DATE(2022, 8,15), /* poniedzia³ek - Œwiêto Wojska Polskiego, Wniebowziêcie Najœwiêtszej Maryi Panny */
PACK_DATE(2022,11, 1), /* wtorek - Wszystkich Œwiêtych */
PACK_DATE(2022,11,11), /* pi¹tek - Œwiêto Niepodleg³oœci */
PACK_DATE(2022,12,25), /* niedziela - Bo¿e Narodzenie (pierwszy dzieñ) */
PACK_DATE(2022,12,26), /* poniedzia³ek - Bo¿e Narodzenie (drugi dzieñ) */
PACK_DATE(2023, 1, 1), /* niedziela - Nowy Rok, Œwiêtej Bo¿ej Rodzicielki */
PACK_DATE(2023, 1, 6), /* pi¹tek - Trzech Króli (Objawienie Pañskie) */
PACK_DATE(2023, 4, 9), /* niedziela - Wielkanoc */
PACK_DATE(2023, 4,10), /* poniedzia³ek - Poniedzia³ek Wielkanocny */
PACK_DATE(2023, 5, 1), /* poniedzia³ek - Œwiêto Pracy */
PACK_DATE(2023, 5, 3), /* œroda - Œwiêto Konstytucji 3 maja */
PACK_DATE(2023, 5,28), /* niedziela - Zes³anie Ducha Œwiêtego (Zielone Œwi¹tki) */
PACK_DATE(2023, 6, 8), /* czwartek - Bo¿e Cia³o */
PACK_DATE(2023, 8,15), /* wtorek - Œwiêto Wojska Polskiego, Wniebowziêcie Najœwiêtszej Maryi Panny */
PACK_DATE(2023,11, 1), /* œroda - Wszystkich Œwiêtych */
PACK_DATE(2023,11,11), /* sobota - Œwiêto Niepodleg³oœci */
PACK_DATE(2023,12,25), /* poniedzia³ek - Bo¿e Narodzenie (pierwszy dzieñ) */
PACK_DATE(2023,12,26), /* wtorek - Bo¿e Narodzenie (drugi dzieñ) */
PACK_DATE(2024, 1, 1), /* poniedzia³ek - Nowy Rok, Œwiêtej Bo¿ej Rodzicielki */
PACK_DATE(2024, 1, 6), /* sobota - Trzech Króli (Objawienie Pañskie) */
PACK_DATE(2024, 3,31), /* niedziela - Wielkanoc */
PACK_DATE(2024, 4, 1), /* poniedzia³ek - Poniedzia³ek Wielkanocny */
PACK_DATE(2024, 5, 1), /* œroda - Œwiêto Pracy */
PACK_DATE(2024, 5, 3), /* pi¹tek - Œwiêto Konstytucji 3 maja */
PACK_DATE(2024, 5,19), /* niedziela - Zes³anie Ducha Œwiêtego (Zielone Œwi¹tki) */
PACK_DATE(2024, 5,30), /* czwartek - Bo¿e Cia³o */
PACK_DATE(2024, 8,15), /* czwartek - Œwiêto Wojska Polskiego, Wniebowziêcie Najœwiêtszej Maryi Panny */
PACK_DATE(2024,11, 1), /* pi¹tek - Wszystkich Œwiêtych */
PACK_DATE(2024,11,11), /* poniedzia³ek - Œwiêto Niepodleg³oœci */
PACK_DATE(2024,12,25), /* œroda - Bo¿e Narodzenie (pierwszy dzieñ) */
PACK_DATE(2024,12,26), /* czwartek - Bo¿e Narodzenie (drugi dzieñ) */
PACK_DATE(2025, 1, 1), /* œroda - Nowy Rok, Œwiêtej Bo¿ej Rodzicielki */
PACK_DATE(2025, 1, 6), /* poniedzia³ek - Trzech Króli (Objawienie Pañskie) */
PACK_DATE(2025, 4,20), /* niedziela - Wielkanoc */
PACK_DATE(2025, 4,21), /* poniedzia³ek - Poniedzia³ek Wielkanocny */
PACK_DATE(2025, 5, 1), /* czwartek - Œwiêto Pracy */
PACK_DATE(2025, 5, 3), /* sobota - Œwiêto Konstytucji 3 maja */
PACK_DATE(2025, 6, 8), /* niedziela - Zes³anie Ducha Œwiêtego (Zielone Œwi¹tki) */
PACK_DATE(2025, 6,19), /* czwartek - Bo¿e Cia³o */
PACK_DATE(2025, 8,15), /* pi¹tek - Œwiêto Wojska Polskiego, Wniebowziêcie Najœwiêtszej Maryi Panny */
PACK_DATE(2025,11, 1), /* sobota - Wszystkich Œwiêtych */
PACK_DATE(2025,11,11), /* wtorek - Œwiêto Niepodleg³oœci */
PACK_DATE(2025,12,25), /* czwartek - Bo¿e Narodzenie (pierwszy dzieñ) */
PACK_DATE(2025,12,26), /* pi¹tek - Bo¿e Narodzenie (drugi dzieñ) */
PACK_DATE(2026, 1, 1), /* czwartek - Nowy Rok, Œwiêtej Bo¿ej Rodzicielki */
PACK_DATE(2026, 1, 6), /* wtorek - Trzech Króli (Objawienie Pañskie) */
PACK_DATE(2026, 4, 5), /* niedziela - Wielkanoc */
PACK_DATE(2026, 4, 6), /* poniedzia³ek - Poniedzia³ek Wielkanocny */
PACK_DATE(2026, 5, 1), /* pi¹tek - Œwiêto Pracy */
PACK_DATE(2026, 5, 3), /* niedziela - Œwiêto Konstytucji 3 maja */
PACK_DATE(2026, 5,24), /* niedziela - Zes³anie Ducha Œwiêtego (Zielone Œwi¹tki) */
PACK_DATE(2026, 6, 4), /* czwartek - Bo¿e Cia³o */
PACK_DATE(2026, 8,15), /* sobota - Œwiêto Wojska Polskiego, Wniebowziêcie Najœwiêtszej Maryi Panny */
PACK_DATE(2026,11, 1), /* niedziela - Wszystkich Œwiêtych */
PACK_DATE(2026,11,11), /* œroda - Œwiêto Niepodleg³oœci */
PACK_DATE(2026,12,25), /* pi¹tek - Bo¿e Narodzenie (pierwszy dzieñ) */
PACK_DATE(2026,12,26), /* sobota - Bo¿e Narodzenie (drugi dzieñ) */
PACK_DATE(2027, 1, 1), /* pi¹tek - Nowy Rok, Œwiêtej Bo¿ej Rodzicielki */
PACK_DATE(2027, 1, 6), /* œroda - Trzech Króli (Objawienie Pañskie) */
PACK_DATE(2027, 3,28), /* niedziela - Wielkanoc */
PACK_DATE(2027, 3,29), /* poniedzia³ek - Poniedzia³ek Wielkanocny */
PACK_DATE(2027, 5, 1), /* sobota - Œwiêto Pracy */
PACK_DATE(2027, 5, 3), /* poniedzia³ek - Œwiêto Konstytucji 3 maja */
PACK_DATE(2027, 5,16), /* niedziela - Zes³anie Ducha Œwiêtego (Zielone Œwi¹tki) */
PACK_DATE(2027, 5,27), /* czwartek - Bo¿e Cia³o */
PACK_DATE(2027, 8,15), /* niedziela - Œwiêto Wojska Polskiego, Wniebowziêcie Najœwiêtszej Maryi Panny */
PACK_DATE(2027,11, 1), /* poniedzia³ek - Wszystkich Œwiêtych */
PACK_DATE(2027,11,11), /* czwartek - Œwiêto Niepodleg³oœci */
PACK_DATE(2027,12,25), /* sobota - Bo¿e Narodzenie (pierwszy dzieñ) */
PACK_DATE(2027,12,26), /* niedziela - Bo¿e Narodzenie (drugi dzieñ) */
PACK_DATE(2028, 1, 1), /* sobota - Nowy Rok, Œwiêtej Bo¿ej Rodzicielki */
PACK_DATE(2028, 1, 6), /* czwartek - Trzech Króli (Objawienie Pañskie) */
PACK_DATE(2028, 4,16), /* niedziela - Wielkanoc */
PACK_DATE(2028, 4,17), /* poniedzia³ek - Poniedzia³ek Wielkanocny */
PACK_DATE(2028, 5, 1), /* poniedzia³ek - Œwiêto Pracy */
PACK_DATE(2028, 5, 3), /* œroda - Œwiêto Konstytucji 3 maja */
PACK_DATE(2028, 6, 4), /* niedziela - Zes³anie Ducha Œwiêtego (Zielone Œwi¹tki) */
PACK_DATE(2028, 6,15), /* czwartek - Bo¿e Cia³o */
PACK_DATE(2028, 8,15), /* wtorek - Œwiêto Wojska Polskiego, Wniebowziêcie Najœwiêtszej Maryi Panny */
PACK_DATE(2028,11, 1), /* œroda - Wszystkich Œwiêtych */
PACK_DATE(2028,11,11), /* sobota - Œwiêto Niepodleg³oœci */
PACK_DATE(2028,12,25), /* poniedzia³ek - Bo¿e Narodzenie (pierwszy dzieñ) */
PACK_DATE(2028,12,26), /* wtorek - Bo¿e Narodzenie (drugi dzieñ) */
PACK_DATE(2029, 4, 1), /* niedziela - Wielkanoc */
PACK_DATE(2029, 4, 2), /* poniedzia³ek - Poniedzia³ek Wielkanocny */
PACK_DATE(2029, 5, 1), /* wtorek - Œwiêto Pracy */
PACK_DATE(2029, 5, 3), /* czwartek - Œwiêto Konstytucji 3 maja */
PACK_DATE(2029, 5,20), /* niedziela - Zes³anie Ducha Œwiêtego (Zielone Œwi¹tki) */
PACK_DATE(2029, 5,31), /* czwartek - Bo¿e Cia³o */
PACK_DATE(2029, 8,15), /* œroda - Œwiêto Wojska Polskiego, Wniebowziêcie Najœwiêtszej Maryi Panny */
PACK_DATE(2029,11, 1), /* czwartek - Wszystkich Œwiêtych */
PACK_DATE(2029,11,11), /* niedziela - Œwiêto Niepodleg³oœci */
PACK_DATE(2029,12,25), /* wtorek - Bo¿e Narodzenie (pierwszy dzieñ) */
PACK_DATE(2029,12,26), /* œroda - Bo¿e Narodzenie (drugi dzieñ) */
PACK_DATE(2030, 1, 1), /* wtorek - Nowy Rok, Œwiêtej Bo¿ej Rodzicielki */
PACK_DATE(2030, 1, 6), /* niedziela - Trzech Króli (Objawienie Pañskie) */
PACK_DATE(2030, 4,21), /* niedziela - Wielkanoc */
PACK_DATE(2030, 4,22), /* poniedzia³ek - Poniedzia³ek Wielkanocny */
PACK_DATE(2030, 5, 1), /* œroda - Œwiêto Pracy */
PACK_DATE(2030, 5, 3), /* pi¹tek - Œwiêto Konstytucji 3 maja */
PACK_DATE(2030, 6, 9), /* niedziela - Zes³anie Ducha Œwiêtego (Zielone Œwi¹tki) */
PACK_DATE(2030, 6,20), /* czwartek - Bo¿e Cia³o */
PACK_DATE(2030, 8,15), /* czwartek - Œwiêto Wojska Polskiego, Wniebowziêcie Najœwiêtszej Maryi Panny */
PACK_DATE(2030,11, 1), /* pi¹tek - Wszystkich Œwiêtych */
PACK_DATE(2030,11,11), /* poniedzia³ek - Œwiêto Niepodleg³oœci */
PACK_DATE(2030,12,25), /* œroda - Bo¿e Narodzenie (pierwszy dzieñ) */
PACK_DATE(2030,12,26), /* czwartek - Bo¿e Narodzenie (drugi dzieñ) */
