PACK_DATE(2017,01,01), /* niedziela - Nowy Rok, Œwiêtej Bo¿ej Rodzicielki */
PACK_DATE(2017,01,06), /* pi¹tek - Trzech Króli (Objawienie Pañskie) */
PACK_DATE(2017,04,16), /* niedziela - Wielkanoc */
PACK_DATE(2017,04,17), /* poniedzia³ek - Poniedzia³ek Wielkanocny */
PACK_DATE(2017,05,01), /* poniedzia³ek - Œwiêto Pracy */
PACK_DATE(2017,05,03), /* œroda - Œwiêto Konstytucji 3 maja */
PACK_DATE(2017,06,04), /* niedziela - Zes³anie Ducha Œwiêtego (Zielone Œwi¹tki) */
PACK_DATE(2017,06,15), /* czwartek - Bo¿e Cia³o */
PACK_DATE(2017,08,15), /* wtorek - Œwiêto Wojska Polskiego, Wniebowziêcie Najœwiêtszej Maryi Panny */
PACK_DATE(2017,11,01), /* œroda - Wszystkich Œwiêtych */
PACK_DATE(2017,11,11), /* sobota - Œwiêto Niepodleg³oœci */
PACK_DATE(2017,12,25), /* poniedzia³ek - Bo¿e Narodzenie (pierwszy dzieñ) */
PACK_DATE(2017,12,26), /* wtorek - Bo¿e Narodzenie (drugi dzieñ) */
PACK_DATE(2018,01,01), /* poniedzia³ek - Nowy Rok, Œwiêtej Bo¿ej Rodzicielki */
PACK_DATE(2018,01,06), /* sobota - Trzech Króli (Objawienie Pañskie) */
PACK_DATE(2018,04,01), /* niedziela - Wielkanoc */
PACK_DATE(2018,04,02), /* poniedzia³ek - Poniedzia³ek Wielkanocny */
PACK_DATE(2018,05,01), /* wtorek - Œwiêto Pracy */
PACK_DATE(2018,05,03), /* czwartek - Œwiêto Konstytucji 3 maja */
PACK_DATE(2018,05,20), /* niedziela - Zes³anie Ducha Œwiêtego (Zielone Œwi¹tki) */
PACK_DATE(2018,05,31), /* czwartek - Bo¿e Cia³o */
PACK_DATE(2018,08,15), /* œroda - Œwiêto Wojska Polskiego, Wniebowziêcie Najœwiêtszej Maryi Panny */
PACK_DATE(2018,11,01), /* czwartek - Wszystkich Œwiêtych */
PACK_DATE(2018,11,11), /* niedziela - Œwiêto Niepodleg³oœci */
PACK_DATE(2018,12,25), /* wtorek - Bo¿e Narodzenie (pierwszy dzieñ) */
PACK_DATE(2018,12,26), /* œroda - Bo¿e Narodzenie (drugi dzieñ) */
PACK_DATE(2019,01,01), /* wtorek - Nowy Rok, Œwiêtej Bo¿ej Rodzicielki */
PACK_DATE(2019,01,06), /* niedziela - Trzech Króli (Objawienie Pañskie) */
PACK_DATE(2019,04,21), /* niedziela - Wielkanoc */
PACK_DATE(2019,04,22), /* poniedzia³ek - Poniedzia³ek Wielkanocny */
PACK_DATE(2019,05,01), /* œroda - Œwiêto Pracy */
PACK_DATE(2019,05,03), /* pi¹tek - Œwiêto Konstytucji 3 maja */
PACK_DATE(2019,06,09), /* niedziela - Zes³anie Ducha Œwiêtego (Zielone Œwi¹tki) */
PACK_DATE(2019,06,20), /* czwartek - Bo¿e Cia³o */
PACK_DATE(2019,08,15), /* czwartek - Œwiêto Wojska Polskiego, Wniebowziêcie Najœwiêtszej Maryi Panny */
PACK_DATE(2019,11,01), /* pi¹tek - Wszystkich Œwiêtych */
PACK_DATE(2019,11,11), /* poniedzia³ek - Œwiêto Niepodleg³oœci */
PACK_DATE(2019,12,25), /* œroda - Bo¿e Narodzenie (pierwszy dzieñ) */
PACK_DATE(2019,12,26), /* czwartek - Bo¿e Narodzenie (drugi dzieñ) */
PACK_DATE(2020,01,01), /* œroda - Nowy Rok, Œwiêtej Bo¿ej Rodzicielki */
PACK_DATE(2020,01,06), /* poniedzia³ek - Trzech Króli (Objawienie Pañskie) */
PACK_DATE(2020,04,12), /* niedziela - Wielkanoc */
PACK_DATE(2020,04,13), /* poniedzia³ek - Poniedzia³ek Wielkanocny */
PACK_DATE(2020,05,01), /* pi¹tek - Œwiêto Pracy */
PACK_DATE(2020,05,03), /* niedziela - Œwiêto Konstytucji 3 maja */
PACK_DATE(2020,05,31), /* niedziela - Zes³anie Ducha Œwiêtego (Zielone Œwi¹tki) */
PACK_DATE(2020,06,11), /* czwartek - Bo¿e Cia³o */
PACK_DATE(2020,08,15), /* sobota - Œwiêto Wojska Polskiego, Wniebowziêcie Najœwiêtszej Maryi Panny */
PACK_DATE(2020,11,01), /* niedziela - Wszystkich Œwiêtych */
PACK_DATE(2020,11,11), /* œroda - Œwiêto Niepodleg³oœci */
PACK_DATE(2020,12,25), /* pi¹tek - Bo¿e Narodzenie (pierwszy dzieñ) */
PACK_DATE(2020,12,26), /* sobota - Bo¿e Narodzenie (drugi dzieñ) */
PACK_DATE(2021,01,01), /* pi¹tek - Nowy Rok, Œwiêtej Bo¿ej Rodzicielki */
PACK_DATE(2021,01,06), /* œroda - Trzech Króli (Objawienie Pañskie) */
PACK_DATE(2021,04,04), /* niedziela - Wielkanoc */
PACK_DATE(2021,04,05), /* poniedzia³ek - Poniedzia³ek Wielkanocny */
PACK_DATE(2021,05,01), /* sobota - Œwiêto Pracy */
PACK_DATE(2021,05,03), /* poniedzia³ek - Œwiêto Konstytucji 3 maja */
PACK_DATE(2021,05,23), /* niedziela - Zes³anie Ducha Œwiêtego (Zielone Œwi¹tki) */
PACK_DATE(2021,06,03), /* czwartek - Bo¿e Cia³o */
PACK_DATE(2021,08,15), /* niedziela - Œwiêto Wojska Polskiego, Wniebowziêcie Najœwiêtszej Maryi Panny */
PACK_DATE(2021,11,01), /* poniedzia³ek - Wszystkich Œwiêtych */
PACK_DATE(2021,11,11), /* czwartek - Œwiêto Niepodleg³oœci */
PACK_DATE(2021,12,25), /* sobota - Bo¿e Narodzenie (pierwszy dzieñ) */
PACK_DATE(2021,12,26), /* niedziela - Bo¿e Narodzenie (drugi dzieñ) */
PACK_DATE(2022,01,01), /* sobota - Nowy Rok, Œwiêtej Bo¿ej Rodzicielki */
PACK_DATE(2022,01,06), /* czwartek - Trzech Króli (Objawienie Pañskie) */
PACK_DATE(2022,04,17), /* niedziela - Wielkanoc */
PACK_DATE(2022,04,18), /* poniedzia³ek - Poniedzia³ek Wielkanocny */
PACK_DATE(2022,05,01), /* niedziela - Œwiêto Pracy */
PACK_DATE(2022,05,03), /* wtorek - Œwiêto Konstytucji 3 maja */
PACK_DATE(2022,06,05), /* niedziela - Zes³anie Ducha Œwiêtego (Zielone Œwi¹tki) */
PACK_DATE(2022,06,16), /* czwartek - Bo¿e Cia³o */
PACK_DATE(2022,08,15), /* poniedzia³ek - Œwiêto Wojska Polskiego, Wniebowziêcie Najœwiêtszej Maryi Panny */
PACK_DATE(2022,11,01), /* wtorek - Wszystkich Œwiêtych */
PACK_DATE(2022,11,11), /* pi¹tek - Œwiêto Niepodleg³oœci */
PACK_DATE(2022,12,25), /* niedziela - Bo¿e Narodzenie (pierwszy dzieñ) */
PACK_DATE(2022,12,26), /* poniedzia³ek - Bo¿e Narodzenie (drugi dzieñ) */
PACK_DATE(2023,01,01), /* niedziela - Nowy Rok, Œwiêtej Bo¿ej Rodzicielki */
PACK_DATE(2023,01,06), /* pi¹tek - Trzech Króli (Objawienie Pañskie) */
PACK_DATE(2023,04,09), /* niedziela - Wielkanoc */
PACK_DATE(2023,04,10), /* poniedzia³ek - Poniedzia³ek Wielkanocny */
PACK_DATE(2023,05,01), /* poniedzia³ek - Œwiêto Pracy */
PACK_DATE(2023,05,03), /* œroda - Œwiêto Konstytucji 3 maja */
PACK_DATE(2023,05,28), /* niedziela - Zes³anie Ducha Œwiêtego (Zielone Œwi¹tki) */
PACK_DATE(2023,06,08), /* czwartek - Bo¿e Cia³o */
PACK_DATE(2023,08,15), /* wtorek - Œwiêto Wojska Polskiego, Wniebowziêcie Najœwiêtszej Maryi Panny */
PACK_DATE(2023,11,01), /* œroda - Wszystkich Œwiêtych */
PACK_DATE(2023,11,11), /* sobota - Œwiêto Niepodleg³oœci */
PACK_DATE(2023,12,25), /* poniedzia³ek - Bo¿e Narodzenie (pierwszy dzieñ) */
PACK_DATE(2023,12,26), /* wtorek - Bo¿e Narodzenie (drugi dzieñ) */
PACK_DATE(2024,01,01), /* poniedzia³ek - Nowy Rok, Œwiêtej Bo¿ej Rodzicielki */
PACK_DATE(2024,01,06), /* sobota - Trzech Króli (Objawienie Pañskie) */
PACK_DATE(2024,03,31), /* niedziela - Wielkanoc */
PACK_DATE(2024,04,01), /* poniedzia³ek - Poniedzia³ek Wielkanocny */
PACK_DATE(2024,05,01), /* œroda - Œwiêto Pracy */
PACK_DATE(2024,05,03), /* pi¹tek - Œwiêto Konstytucji 3 maja */
PACK_DATE(2024,05,19), /* niedziela - Zes³anie Ducha Œwiêtego (Zielone Œwi¹tki) */
PACK_DATE(2024,05,30), /* czwartek - Bo¿e Cia³o */
PACK_DATE(2024,08,15), /* czwartek - Œwiêto Wojska Polskiego, Wniebowziêcie Najœwiêtszej Maryi Panny */
PACK_DATE(2024,11,01), /* pi¹tek - Wszystkich Œwiêtych */
PACK_DATE(2024,11,11), /* poniedzia³ek - Œwiêto Niepodleg³oœci */
PACK_DATE(2024,12,25), /* œroda - Bo¿e Narodzenie (pierwszy dzieñ) */
PACK_DATE(2024,12,26), /* czwartek - Bo¿e Narodzenie (drugi dzieñ) */
PACK_DATE(2025,01,01), /* œroda - Nowy Rok, Œwiêtej Bo¿ej Rodzicielki */
PACK_DATE(2025,01,06), /* poniedzia³ek - Trzech Króli (Objawienie Pañskie) */
PACK_DATE(2025,04,20), /* niedziela - Wielkanoc */
PACK_DATE(2025,04,21), /* poniedzia³ek - Poniedzia³ek Wielkanocny */
PACK_DATE(2025,05,01), /* czwartek - Œwiêto Pracy */
PACK_DATE(2025,05,03), /* sobota - Œwiêto Konstytucji 3 maja */
PACK_DATE(2025,06,08), /* niedziela - Zes³anie Ducha Œwiêtego (Zielone Œwi¹tki) */
PACK_DATE(2025,06,19), /* czwartek - Bo¿e Cia³o */
PACK_DATE(2025,08,15), /* pi¹tek - Œwiêto Wojska Polskiego, Wniebowziêcie Najœwiêtszej Maryi Panny */
PACK_DATE(2025,11,01), /* sobota - Wszystkich Œwiêtych */
PACK_DATE(2025,11,11), /* wtorek - Œwiêto Niepodleg³oœci */
PACK_DATE(2025,12,25), /* czwartek - Bo¿e Narodzenie (pierwszy dzieñ) */
PACK_DATE(2025,12,26), /* pi¹tek - Bo¿e Narodzenie (drugi dzieñ) */
PACK_DATE(2026,01,01), /* czwartek - Nowy Rok, Œwiêtej Bo¿ej Rodzicielki */
PACK_DATE(2026,01,06), /* wtorek - Trzech Króli (Objawienie Pañskie) */
PACK_DATE(2026,04,05), /* niedziela - Wielkanoc */
PACK_DATE(2026,04,06), /* poniedzia³ek - Poniedzia³ek Wielkanocny */
PACK_DATE(2026,05,01), /* pi¹tek - Œwiêto Pracy */
PACK_DATE(2026,05,03), /* niedziela - Œwiêto Konstytucji 3 maja */
PACK_DATE(2026,05,24), /* niedziela - Zes³anie Ducha Œwiêtego (Zielone Œwi¹tki) */
PACK_DATE(2026,06,04), /* czwartek - Bo¿e Cia³o */
PACK_DATE(2026,08,15), /* sobota - Œwiêto Wojska Polskiego, Wniebowziêcie Najœwiêtszej Maryi Panny */
PACK_DATE(2026,11,01), /* niedziela - Wszystkich Œwiêtych */
PACK_DATE(2026,11,11), /* œroda - Œwiêto Niepodleg³oœci */
PACK_DATE(2026,12,25), /* pi¹tek - Bo¿e Narodzenie (pierwszy dzieñ) */
PACK_DATE(2026,12,26), /* sobota - Bo¿e Narodzenie (drugi dzieñ) */
PACK_DATE(2027,01,01), /* pi¹tek - Nowy Rok, Œwiêtej Bo¿ej Rodzicielki */
PACK_DATE(2027,01,06), /* œroda - Trzech Króli (Objawienie Pañskie) */
PACK_DATE(2027,03,28), /* niedziela - Wielkanoc */
PACK_DATE(2027,03,29), /* poniedzia³ek - Poniedzia³ek Wielkanocny */
PACK_DATE(2027,05,01), /* sobota - Œwiêto Pracy */
PACK_DATE(2027,05,03), /* poniedzia³ek - Œwiêto Konstytucji 3 maja */
PACK_DATE(2027,05,16), /* niedziela - Zes³anie Ducha Œwiêtego (Zielone Œwi¹tki) */
PACK_DATE(2027,05,27), /* czwartek - Bo¿e Cia³o */
PACK_DATE(2027,08,15), /* niedziela - Œwiêto Wojska Polskiego, Wniebowziêcie Najœwiêtszej Maryi Panny */
PACK_DATE(2027,11,01), /* poniedzia³ek - Wszystkich Œwiêtych */
PACK_DATE(2027,11,11), /* czwartek - Œwiêto Niepodleg³oœci */
PACK_DATE(2027,12,25), /* sobota - Bo¿e Narodzenie (pierwszy dzieñ) */
PACK_DATE(2027,12,26), /* niedziela - Bo¿e Narodzenie (drugi dzieñ) */
PACK_DATE(2028,01,01), /* sobota - Nowy Rok, Œwiêtej Bo¿ej Rodzicielki */
PACK_DATE(2028,01,06), /* czwartek - Trzech Króli (Objawienie Pañskie) */
PACK_DATE(2028,04,16), /* niedziela - Wielkanoc */
PACK_DATE(2028,04,17), /* poniedzia³ek - Poniedzia³ek Wielkanocny */
PACK_DATE(2028,05,01), /* poniedzia³ek - Œwiêto Pracy */
PACK_DATE(2028,05,03), /* œroda - Œwiêto Konstytucji 3 maja */
PACK_DATE(2028,06,04), /* niedziela - Zes³anie Ducha Œwiêtego (Zielone Œwi¹tki) */
PACK_DATE(2028,06,15), /* czwartek - Bo¿e Cia³o */
PACK_DATE(2028,08,15), /* wtorek - Œwiêto Wojska Polskiego, Wniebowziêcie Najœwiêtszej Maryi Panny */
PACK_DATE(2028,11,01), /* œroda - Wszystkich Œwiêtych */
PACK_DATE(2028,11,11), /* sobota - Œwiêto Niepodleg³oœci */
PACK_DATE(2028,12,25), /* poniedzia³ek - Bo¿e Narodzenie (pierwszy dzieñ) */
PACK_DATE(2028,12,26), /* wtorek - Bo¿e Narodzenie (drugi dzieñ) */
PACK_DATE(2029,04,01), /* niedziela - Wielkanoc */
PACK_DATE(2029,04,02), /* poniedzia³ek - Poniedzia³ek Wielkanocny */
PACK_DATE(2029,05,01), /* wtorek - Œwiêto Pracy */
PACK_DATE(2029,05,03), /* czwartek - Œwiêto Konstytucji 3 maja */
PACK_DATE(2029,05,20), /* niedziela - Zes³anie Ducha Œwiêtego (Zielone Œwi¹tki) */
PACK_DATE(2029,05,31), /* czwartek - Bo¿e Cia³o */
PACK_DATE(2029,08,15), /* œroda - Œwiêto Wojska Polskiego, Wniebowziêcie Najœwiêtszej Maryi Panny */
PACK_DATE(2029,11,01), /* czwartek - Wszystkich Œwiêtych */
PACK_DATE(2029,11,11), /* niedziela - Œwiêto Niepodleg³oœci */
PACK_DATE(2029,12,25), /* wtorek - Bo¿e Narodzenie (pierwszy dzieñ) */
PACK_DATE(2029,12,26), /* œroda - Bo¿e Narodzenie (drugi dzieñ) */
PACK_DATE(2030,01,01), /* wtorek - Nowy Rok, Œwiêtej Bo¿ej Rodzicielki */
PACK_DATE(2030,01,06), /* niedziela - Trzech Króli (Objawienie Pañskie) */
PACK_DATE(2030,04,21), /* niedziela - Wielkanoc */
PACK_DATE(2030,04,22), /* poniedzia³ek - Poniedzia³ek Wielkanocny */
PACK_DATE(2030,05,01), /* œroda - Œwiêto Pracy */
PACK_DATE(2030,05,03), /* pi¹tek - Œwiêto Konstytucji 3 maja */
PACK_DATE(2030,06,09), /* niedziela - Zes³anie Ducha Œwiêtego (Zielone Œwi¹tki) */
PACK_DATE(2030,06,20), /* czwartek - Bo¿e Cia³o */
PACK_DATE(2030,08,15), /* czwartek - Œwiêto Wojska Polskiego, Wniebowziêcie Najœwiêtszej Maryi Panny */
PACK_DATE(2030,11,01), /* pi¹tek - Wszystkich Œwiêtych */
PACK_DATE(2030,11,11), /* poniedzia³ek - Œwiêto Niepodleg³oœci */
PACK_DATE(2030,12,25), /* œroda - Bo¿e Narodzenie (pierwszy dzieñ) */
PACK_DATE(2030,12,26), /* czwartek - Bo¿e Narodzenie (drugi dzieñ) */
